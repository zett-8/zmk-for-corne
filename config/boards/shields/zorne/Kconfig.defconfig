## config/boards/shields/zorne/Kconfig.defconfig
```kconfig
# Copyright (c) 2022 The ZMK Contributors
# SPDX-License-Identifier: MIT

if SHIELD_ZORNE_LEFT

config ZMK_KEYBOARD_NAME
	default "zorne"

config ZMK_SPLIT_BLE_ROLE_CENTRAL
	default y

endif

if SHIELD_ZORNE_LEFT || SHIELD_ZORNE_RIGHT

config ZMK_SPLIT
	default y

endif
```

## config/boards/shields/zorne/Kconfig.shield
```kconfig
# Copyright (c) 2022 The ZMK Contributors
# SPDX-License-Identifier: MIT

config SHIELD_ZORNE_LEFT
	def_bool $(shields_list_contains,zorne_left)

config SHIELD_ZORNE_RIGHT
	def_bool $(shields_list_contains,zorne_right)
```
